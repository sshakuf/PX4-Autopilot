## src/modules/shadowlift_att_control/Kconfig
```kconfig
menuconfig MODULES_SHADOWLIFT_ATT_CONTROL
	bool "shadowlift_att_control"
	default n
	---help---
		Enable support for shadowlift_att_control

menuconfig USER_SHADOWLIFT_ATT_CONTROL
	bool "shadowlift_att_control running as userspace module"
	default y
	depends on BOARD_PROTECTED && MODULES_SHADOWLIFT_ATT_CONTROL
	---help---
		Put shadowlift_att_control in userspace memory
```
